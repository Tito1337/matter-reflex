## firmware/sdkconfig.defaults
```kconfig
CONFIG_ESPTOOLPY_FLASHSIZE_4MB=y
CONFIG_PARTITION_TABLE_CUSTOM=y
CONFIG_PARTITION_TABLE_CUSTOM_FILENAME="partitions.csv"
CONFIG_PARTITION_TABLE_OFFSET=0xC000
CONFIG_ENABLE_OTA_REQUESTOR=n
CONFIG_ESP_CONSOLE_USB_SERIAL_JTAG=y
CONFIG_ENABLE_CHIP_SHELL=n
CONFIG_CHIP_TASK_STACK_SIZE=12288
CONFIG_ESP_MAIN_TASK_STACK_SIZE=8192
CONFIG_ESP_MATTER_MAX_DYNAMIC_ENDPOINT_COUNT=3
CONFIG_MBEDTLS_HKDF_C=y

# Preconfigured full Thread device using the integrated 802.15.4 radio.
CONFIG_OPENTHREAD_ENABLED=y
CONFIG_OPENTHREAD_FTD=y
CONFIG_OPENTHREAD_SRP_CLIENT=y
CONFIG_OPENTHREAD_DNS_CLIENT=y
CONFIG_OPENTHREAD_CLI=n
CONFIG_ENABLE_WIFI_STATION=n
CONFIG_ESP_WIFI_SOFTAP_SUPPORT=n
CONFIG_WIFI_NETWORK_COMMISSIONING_DRIVER=n
CONFIG_BT_ENABLED=n
CONFIG_ENABLE_CHIPOBLE=n
CONFIG_USE_MINIMAL_MDNS=n
CONFIG_LWIP_IPV6_AUTOCONFIG=n
CONFIG_LWIP_IPV6_NUM_ADDRESSES=8
CONFIG_LWIP_MULTICAST_PING=y
CONFIG_LWIP_HOOK_IP6_ROUTE_DEFAULT=y
CONFIG_LWIP_HOOK_ND6_GET_GW_DEFAULT=y
CONFIG_LWIP_IPV6=y

# Each board has a private random onboarding code in its own fctry partition.
# Development attestation uses CHIP's test VID/PID and example DAC.
CONFIG_ENABLE_ESP32_FACTORY_DATA_PROVIDER=y
CONFIG_FACTORY_COMMISSIONABLE_DATA_PROVIDER=y
CONFIG_EXAMPLE_DAC_PROVIDER=y
CONFIG_ENABLE_ESP32_DEVICE_INSTANCE_INFO_PROVIDER=y
CONFIG_FACTORY_DEVICE_INSTANCE_INFO_PROVIDER=y
CONFIG_DEVICE_VENDOR_ID=0xFFF1
CONFIG_DEVICE_PRODUCT_ID=0x8000
CONFIG_CHIP_FACTORY_NAMESPACE_PARTITION_LABEL="fctry"
```
